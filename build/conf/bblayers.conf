## build/conf/bblayers.conf
```bitbake
# POKY_BBLAYERS_CONF_VERSION is increased each time build/conf/bblayers.conf
# changes incompatibly
POKY_BBLAYERS_CONF_VERSION = "2"

BBPATH = "${TOPDIR}"
BBFILES ?= ""

BBLAYERS ?= " \
  ${TOPDIR}/../.build-linux/poky/meta \
  ${TOPDIR}/../.build-linux/poky/meta-poky \
  ${TOPDIR}/../.build-linux/poky/meta-yocto-bsp \
  ${TOPDIR}/../.build-linux/meta-xilinx/meta-xilinx-bsp \
  ${TOPDIR}/../.build-linux/meta-gplv2 \
  ${TOPDIR}/../.build-linux/meta-openembedded/meta-oe \
  ${TOPDIR}/../.build-linux/meta-openembedded/meta-python \
  ${TOPDIR}/../.build-linux/meta-openembedded/meta-networking \
  ${TOPDIR}/..//layers/meta-black \
  "

BBLAYERS_NON_REMOVABLE ?= " \
  ${TOPDIR}/../meta \
  ${TOPDIR}/../meta-poky \
  "
```

## layers/meta-black/conf/layer.conf
```bitbake
# starburst custom layer
BBPATH .= ":${LAYERDIR}"

# add recipes
BBFILES += "${LAYERDIR}/recipes-*/*/*.bb \
            ${LAYERDIR}/recipes-*/*/*.bbappend "

# NOTE: This layer collection is called hack
BBFILE_COLLECTIONS += "meta-black"
BBFILE_PATTERN_meta-black := "^${LAYERDIR}/"
BBFILE_PRIORITY_meta-black = "10"
LAYERSERIES_COMPAT_meta-black = "sumo"
```

## layers/meta-hack-rk3288/conf/distro/hack-linux.conf
```bitbake
# Something to be written here
require conf/distro/poky.conf

DISTRO_NAME = "hack-linux-productions"
DISTRO_VERSION = "0.1"


POKY_DEFAULT_DISTRO_FEATURES = ""
DISTRO_FEATURES_DEFAULT = "acl argp ext4 largefiles xattr pam systemd dbus"


HOSTTOOLS += " xz "
```

## layers/meta-hack-rk3288/conf/layer.conf
```bitbake
# starburst custom layer
BBPATH .= ":${LAYERDIR}"

# add recipes
BBFILES += "${LAYERDIR}/recipes-*/*/*.bb \
            ${LAYERDIR}/recipes-*/*/*.bbappend "

# NOTE: This layer collection is called hack
BBFILE_COLLECTIONS += "meta-hack"
BBFILE_PATTERN_meta-hack := "^${LAYERDIR}/"
BBFILE_PRIORITY_meta-hack = "6"
LAYERSERIES_COMPAT_meta-hack = "dunfell"
```

## layers/meta-hack-rk3288/conf/machine/hack-rk3288.conf
```bitbake
# Something to be written here

require conf/machine/tinker-board.conf


#Kernel configuration
PREFERRED_PROVIDER_virtual/kernel ?= "linux-yocto"
SERIAL_CONSOLES += "115200;ttymxc0"


IMAGE_FSTYPES += "ext4 sdimg"
```

## layers/meta-r3-rk3288/conf/layer.conf
```bitbake
# starburst custom layer
BBPATH .= ":${LAYERDIR}"

# add recipes
BBFILES += "${LAYERDIR}/recipes-*/*/*.bb \
            ${LAYERDIR}/recipes-*/*/*.bbappend "


BBFILE_COLLECTIONS += "r3-layer"
BBFILE_PATTERN_r3-layer := "^${LAYERDIR}/"
BBFILE_PRIORITY_r3-layer = "30"
LAYERSERIES_COMPAT_r3-layer = "dunfell"

WKS_FILE ?= "starburst-rk3399.wks"

# Following two lines to be shifted to core-image-starburst-box.bb once build errors induced are understood
PACKAGECONFIG_append_pn-libgpiod = " python3"
```

## layers/meta-zedboard/conf/layer.conf
```bitbake
# starburst custom layer
BBPATH .= ":${LAYERDIR}"

# add recipes
BBFILES += "${LAYERDIR}/recipes-*/*/*.bb \
            ${LAYERDIR}/recipes-*/*/*.bbappend "

# NOTE: This layer collection is called hack
BBFILE_COLLECTIONS += "meta-zedboard"
BBFILE_PATTERN_meta-zedboard := "^${LAYERDIR}/"
BBFILE_PRIORITY_meta-zedboard = "10"
LAYERSERIES_COMPAT_meta-zedboard = "sumo"
```

## layers/meta-zedboard/conf/machine/zedboard.conf
```bitbake
# Something to be written here

require conf/machine/zedboard-zynq7.conf


IMAGE_FSTYPES += "ext4 wic"
```
